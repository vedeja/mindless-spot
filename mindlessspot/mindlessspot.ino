// MindlessSpot -- minimal single-fixture DMX spotlight controller.
// Author: Stefan Vedeja
// License: MIT License (../LICENSE)
//
// Hardware: Arduino UNO R4 WiFi, Modulino Joystick, Modulino Knob, Whadda
// DMX512 module (driven from Serial1 TX, pin 1).
//
// The joystick moves pan/tilt at a speed proportional to its deflection
// Turning the knob changes the dimmer. All settings are hard coded below.

#include <Arduino.h>
#include <Arduino_Modulino.h>
#include <string.h>

// ---------------------------------------------------------------------------
// Fixture settings (1-based DMX channels)
// ---------------------------------------------------------------------------
constexpr uint16_t PAN_CHANNEL = 1;
constexpr uint16_t TILT_CHANNEL = 3;
constexpr uint16_t DIMMER_CHANNEL = 12;

constexpr uint8_t PAN_DMX_MIN = 110;
constexpr uint8_t PAN_DMX_MAX = 160;
constexpr uint8_t TILT_DMX_MIN = 40;
constexpr uint8_t TILT_DMX_MAX = 60;

constexpr bool PAN_INVERT = false;
constexpr bool TILT_INVERT = false;

struct StaticChannel {
  uint16_t channel;
  uint8_t value;
};

// Channels that always carry a fixed value (shutter open, color wheel, ...).
constexpr StaticChannel STATIC_CHANNELS[] = {
  {5, 0},
  {6, 120},
  {11, 255},
  {13, 4}
};

// ---------------------------------------------------------------------------
// Control tuning
// ---------------------------------------------------------------------------
// Reference time to sweep the whole min..max range at a rate of 1.
constexpr float FULL_SWEEP_SECONDS = 1.0f;
constexpr int16_t JOYSTICK_DEADZONE = 8;
constexpr int16_t JOYSTICK_FULL_SCALE = 127;
constexpr float JOYSTICK_MAX_RATE = 1.5f;

constexpr int16_t DIMMER_STEP_PER_KNOB_TICK = 5; // percent
constexpr int16_t DIMMER_START_PERCENT = 0;
constexpr int32_t MAX_KNOB_TICKS_PER_READ = 16;
constexpr unsigned long KNOB_SETTLE_MS = 20;
constexpr unsigned long KNOB_RECOVERY_MS = 100;
constexpr unsigned long KNOB_BUTTON_DEBOUNCE_MS = 30;

// ---------------------------------------------------------------------------
// DMX output
// ---------------------------------------------------------------------------
#if defined(PIN_SERIAL1_TX)
constexpr uint8_t DMX_TX_PIN = PIN_SERIAL1_TX;
#else
constexpr uint8_t DMX_TX_PIN = 1;
#endif
constexpr uint16_t DMX_BREAK_US = 120;
constexpr uint16_t DMX_MAB_US = 12;
constexpr unsigned long DMX_KEEPALIVE_MS = 200;

ModulinoJoystick joystick;
ModulinoKnob knob;

uint8_t dmxFrame[513];
uint8_t sentFrame[513];
uint16_t dmxFrameLength = 1;
unsigned long lastDmxSendMs = 0;

// Normalized 0..1 position within each axis' min..max range.
float panPos = 0.5f;
float tiltPos = 0.5f;
int16_t dimmerPercent = DIMMER_START_PERCENT;
bool knobButtonRaw = false;
bool knobButtonPressed = false;
unsigned long lastKnobButtonChangeMs = 0;
uint16_t lastKnobValue = 0;
bool haveKnobValue = false;
bool knobRecovering = false;
int32_t pendingKnobDelta = 0;
unsigned long lastKnobChangeMs = 0;
unsigned long lastLoopMs = 0;

void setChannel(uint16_t channel, uint8_t value) {
  if (channel >= 1 && channel <= 512) {
    dmxFrame[channel] = value;
    if (channel > dmxFrameLength) {
      dmxFrameLength = channel;
    }
  }
}

uint8_t axisToDmx(float pos, uint8_t minValue, uint8_t maxValue) {
  return static_cast<uint8_t>(minValue + (maxValue - minValue) * pos + 0.5f);
}

// Gamma-corrected so the knob feels linear to the eye.
uint8_t dimmerToDmx(int16_t percent) {
  float n = constrain(percent, 0, 100) / 100.0f;
  return static_cast<uint8_t>(n * n * 255.0f + 0.5f);
}

float joystickRate(int16_t raw) {
  if (abs(raw) < JOYSTICK_DEADZONE) {
    return 0.0f;
  }
  float deflection = constrain(raw / static_cast<float>(JOYSTICK_FULL_SCALE), -1.0f, 1.0f);
  float magnitude = abs(deflection);
  return deflection * magnitude * (0.5f + 0.5f * magnitude) * JOYSTICK_MAX_RATE;
}

void buildFrame() {
  memset(dmxFrame, 0, sizeof(dmxFrame));
  for (const StaticChannel &s : STATIC_CHANNELS) {
    setChannel(s.channel, s.value);
  }
  setChannel(PAN_CHANNEL, axisToDmx(panPos, PAN_DMX_MIN, PAN_DMX_MAX));
  setChannel(TILT_CHANNEL, axisToDmx(tiltPos, TILT_DMX_MIN, TILT_DMX_MAX));
  setChannel(DIMMER_CHANNEL, dimmerToDmx(dimmerPercent));
}

bool frameNeedsSend() {
  return memcmp(dmxFrame, sentFrame, sizeof(dmxFrame)) != 0 ||
         (millis() - lastDmxSendMs) >= DMX_KEEPALIVE_MS;
}

// Break/MAB are generated by briefly taking the TX pin away from the UART.
void sendFrame() {
  Serial1.flush();
  Serial1.end();
  pinMode(DMX_TX_PIN, OUTPUT);
  digitalWrite(DMX_TX_PIN, LOW);
  delayMicroseconds(DMX_BREAK_US);
  digitalWrite(DMX_TX_PIN, HIGH);
  delayMicroseconds(DMX_MAB_US);
  Serial1.begin(250000, SERIAL_8N2);

  for (uint16_t i = 0; i <= dmxFrameLength; ++i) {
    Serial1.write(dmxFrame[i]);
  }

  memcpy(sentFrame, dmxFrame, sizeof(dmxFrame));
  lastDmxSendMs = millis();
}

void updateKnobButton(bool pressed) {
  if (pressed != knobButtonRaw) {
    knobButtonRaw = pressed;
    lastKnobButtonChangeMs = millis();
  }
  if (pressed != knobButtonPressed &&
      (millis() - lastKnobButtonChangeMs) >= KNOB_BUTTON_DEBOUNCE_MS) {
    knobButtonPressed = pressed;
    if (pressed) {
      dimmerPercent = dimmerPercent == 0 ? 100 : 0;
      pendingKnobDelta = 0;
    }
  }
}

void readKnob() {
  uint8_t data[3];
  if (!knob.read(data, sizeof(data))) {
    if (knobRecovering) lastKnobChangeMs = millis();
    lastKnobButtonChangeMs = millis();
    return;
  }
  updateKnobButton(data[2] != 0);
  uint16_t value = static_cast<uint16_t>(data[0]) |
                   (static_cast<uint16_t>(data[1]) << 8);
  if (!haveKnobValue) {
    lastKnobValue = value;
    haveKnobValue = true;
    return;
  }
  int32_t delta = static_cast<int32_t>(value) - lastKnobValue;
  if (delta > 32767) delta -= 65536;
  if (delta < -32768) delta += 65536;
  lastKnobValue = value;
  if (delta > MAX_KNOB_TICKS_PER_READ || delta < -MAX_KNOB_TICKS_PER_READ) {
    knobRecovering = true;
    pendingKnobDelta = 0;
    lastKnobChangeMs = millis();
    return;
  }
  if (knobRecovering) {
    if (delta != 0) {
      lastKnobChangeMs = millis();
    } else if ((millis() - lastKnobChangeMs) >= KNOB_RECOVERY_MS) {
      knobRecovering = false;
    }
    return;
  }
  if (delta != 0) {
    pendingKnobDelta = constrain(pendingKnobDelta + delta, -65536L, 65536L);
    lastKnobChangeMs = millis();
  }
  if (pendingKnobDelta != 0 &&
      (millis() - lastKnobChangeMs) >= KNOB_SETTLE_MS) {
    dimmerPercent = constrain(dimmerPercent + pendingKnobDelta * DIMMER_STEP_PER_KNOB_TICK, 0, 100);
    pendingKnobDelta = 0;
  }
}

void readJoystick(float dtSeconds) {
  uint8_t data[3];
  if (!joystick.read(data, sizeof(data))) {
    return;
  }
  joystick.map_value(data[0], data[1]);
  int16_t joystickX = 128 - static_cast<int16_t>(data[0]);
  int16_t joystickY = 128 - static_cast<int16_t>(data[1]);
  float step = dtSeconds / FULL_SWEEP_SECONDS;
  // The Modulino Joystick is mounted rotated: its Y axis is horizontal.
  float panRate = joystickRate(joystickY);
  float tiltRate = joystickRate(joystickX);
  if (PAN_INVERT) panRate = -panRate;
  if (TILT_INVERT) tiltRate = -tiltRate;
  panPos = constrain(panPos + panRate * step, 0.0f, 1.0f);
  tiltPos = constrain(tiltPos + tiltRate * step, 0.0f, 1.0f);
}

void setup() {
  Serial1.begin(250000, SERIAL_8N2);

  Modulino.begin();
  joystick.begin();
  knob.begin();
  readKnob();

  // Force the first frame out immediately.
  memset(sentFrame, 0xFF, sizeof(sentFrame));
  lastLoopMs = millis();
}

void loop() {
  readKnob();

  unsigned long nowMs = millis();
  float dtSeconds = constrain((nowMs - lastLoopMs) / 1000.0f, 0.001f, 0.2f);
  lastLoopMs = nowMs;

  readJoystick(dtSeconds);
  buildFrame();

  if (frameNeedsSend()) {
    sendFrame();
  } else {
    delay(2);
  }
}
